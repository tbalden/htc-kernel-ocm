qcom,ocm-id1-batterydata {
	qcom, = <24>;
	qcom,max-voltage-uv = <4400000>;
	qcom,nom-batt-capacity-mah = <3830>;
	qcom,batt-id-kohm = <22>;
	qcom,battery-beta = <4360>;
	qcom,battery-type = "ocm_id1";
	qcom,checksum = <0xC2CF>;
	qcom,gui-version = "PMI8998GUI - 2.0.0.58";

	qcom,fastchg-current-ma = <3250>;
	qcom,fg-cc-cv-threshold-mv = <4390>;
	qqcom,fcc-mah = <3830>;

	htc,batt_id = <1>;
	htc,id_raw_min = <0>;
	htc,id_raw_max = <63000>;

	qcom,fg-profile-data = [
		 83 1F 94 05
		 8F 0A 5D FC
		 75 1D 5D 07
		 2C 12 55 14
		 69 19 F7 1B
		 68 3D 48 4A
		 52 00 00 00
		 16 00 00 00
		 00 00 5D C5
		 6B C5 AA AA
		 1A 00 08 00
		 A4 DA 5C E5
		 A2 F4 62 EA
		 36 01 B3 0B
		 21 05 9C 32
		 16 06 09 20
		 27 00 14 00
		 C5 1F 86 05
		 87 0A 44 06
		 59 1D DA EB
		 37 0A 72 15
		 46 19 D0 22
		 87 45 F1 52
		 55 00 00 00
		 0E 00 00 00
		 00 00 82 CC
		 CB C2 F9 B2
		 17 00 00 00
		 F7 E3 5C E5
		 5D 07 8E E2
		 8E F3 79 0A
		 7B 06 AD 1A
		 99 33 CC FF
		 07 10 00 00
		 60 0F 66 46
		 17 00 40 00
		 A8 01 0A FA
		 FF 00 00 00
		 00 00 00 00
		 00 00 00 00
		 00 00 00 00
		 00 00 00 00
		 00 00 00 00
		 00 00 00 00
		 00 00 00 00
		 00 00 00 00
		 00 00 00 00
		 00 00 00 00
		 00 00 00 00
		 00 00 00 00
		 00 00 00 00
		 00 00 00 00
		 00 00 00 00
		 00 00 00 00
		 00 00 00 00
		 00 00 00 00
	];
};

