/* Copyright (c) 2016, The Linux Foundation. All rights reserved.
 *
 * This program is free software; you can redistribute it and/or modify
 * it under the terms of the GNU General Public License version 2 and
 * only version 2 as published by the Free Software Foundation.
 *
 * This program is distributed in the hope that it will be useful,
 * but WITHOUT ANY WARRANTY; without even the implied warranty of
 * MERCHANTABILITY or FITNESS FOR A PARTICULAR PURPOSE.  See the
 * GNU General Public License for more details.
 */


/dts-v1/;

#include "../qcom/msm8998-v2.1.dtsi"
#include "msm8998-htc_ocm.dtsi"
#include "msm8998-nc-pins-htc_ocm.dtsi"
#include "msm8998-camera-sensor-ocm.dtsi"
#include "msm8998-htc_ocm-usb-xc.dtsi"

/ {
	model = "HTC Corporation. MSM8998 v2.1 OCM XC";
	qcom,msm-id = <460 0x20001>, <461 0x20001>, <462 0x20001>;
	qcom,board-id = <2 0>;
};

&pm8998_l19 {
        regulator-min-microvolt = <2850000>;
        regulator-max-microvolt = <2850000>;
        qcom,init-voltage = <2850000>;
        qcom,init-ldo-mode = <1>;
        regulator-always-on;
        status = "okay";
};
