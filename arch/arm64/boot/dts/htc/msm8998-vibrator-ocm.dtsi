&pmi8998_haptics {
	status = "okay";
	compatible = "qcom,qpnp-haptic";
	qcom,actuator-type = "lra";
	qcom,play-mode = "direct";
	qcom,vmax-mv = <2828>;
	qcom,ilim-ma = <800>;
	qcom,wave-shape = "sine";
	qcom,wave-play-rate-us = <4255>;
	qcom,int-pwm-freq-khz = <505>;
	qcom,sc-deb-cycles = <8>;
	qcom,en-brake;
	qcom,brake-pattern = [03 03 03 03];
	qcom,use-play-irq;
	qcom,use-sc-irq;
	qcom,lra-high-z = "opt1";
	qcom,lra-auto-res-mode = "qwd";
	qcom,lra-res-cal-period = <4>;
	qcom,correct-lra-drive-freq;
};
